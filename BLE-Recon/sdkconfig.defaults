## Wifi-Wardriving/main/Kconfig.projbuild
```kconfig
menu "Wardrive (sensor sigiloso)"

    config WARDRIVE_WIFI_SSID
        string "SSID del hotspot oculto del móvil"
        default ""
        help
            Nombre (SSID) del hotspot oculto WPA2 creado en el móvil.
            Configúralo con `idf.py menuconfig`: el valor queda SOLO en
            sdkconfig (ignorado por git) y nunca se commitea.

    config WARDRIVE_WIFI_PASS
        string "Clave WPA2 del hotspot"
        default ""
        help
            Clave WPA2 del hotspot (mínimo 8 caracteres). Igual que el
            SSID: solo en sdkconfig, nunca en el repositorio.

    config WARDRIVE_LISTENER_PORT
        int "Puerto del listener en el móvil"
        range 1 65535
        default 47471
        help
            Puerto TCP del listener Python (tools/listener.py) que corre
            en el gateway (el móvil). [CONGELADO: 47471]

    config WARDRIVE_SCAN_INTERVAL_MS
        int "Ciclo de escaneo (ms entre inicios)"
        range 5000 3600000
        default 15000
        help
            Tiempo entre el INICIO de dos escaneos consecutivos.
            [CONGELADO: 15000]

    config WARDRIVE_MAX_APS
        int "Tope de APs por escaneo"
        range 1 128
        default 128
        help
            Número máximo de registros de AP retenidos por escaneo.
            [CONGELADO: 128]

    config WARDRIVE_RING_SLOTS
        int "Slots del ring buffer (escaneos crudos en RAM)"
        range 1 32
        default 8
        help
            Escaneos retenidos en RAM ante cortes de enlace (sin flash).
            [CONGELADO: 8]

    config WARDRIVE_TX_POWER
        int "Potencia TX máxima (unidades de 0.25 dBm)"
        range 8 84
        default 40
        help
            40 = 10 dBm (mínimo práctico del ESP32-S3). Rango válido 8-84.
            Se aplica justo después de esp_wifi_start() (ROADMAP §3.2).

    config WARDRIVE_WIFI_ALL_CHANNEL_SCAN
        bool "Fallback: escaneo completo de canales al asociar"
        default n
        help
            Activa .sta.scan_method=WIFI_ALL_CHANNEL_SCAN y
            .sort_method=WIFI_CONNECT_AP_BY_SIGNAL. Activar SOLO si la
            asociación al SSID oculto falla con los valores por defecto
            (ROADMAP §3.2).

    config WARDRIVE_PCAP_ENABLE
        bool "Captura selectiva PCAP + Radiotap (MGMT + Handshakes EAPOL)"
        default y
        help
            Almacena en RAM las tramas 802.11 de gestión (Beacon deduplicado
            por ciclo, Probe Req/Resp, Assoc/Auth, Deauth/Disassoc) y las
            tramas de datos EAPOL (4-way handshake WPA2/WPA3) con cabecera
            Radiotap (DLT 127) y las envía por HTTP POST /pcap al móvil.

    config WARDRIVE_PCAP_BUF_KB
        int "Tamaño del buffer RAM para paquetes PCAP (KB)"
        depends on WARDRIVE_PCAP_ENABLE
        range 8 128
        default 16
        help
            Capacidad estática en RAM reservada para encolar tramas PCAP
            entre envíos HTTP al listener.

    config WARDRIVE_PCAP_SNAPLEN
        int "Longitud máxima de captura por trama PCAP (snaplen bytes)"
        depends on WARDRIVE_PCAP_ENABLE
        range 128 1600
        default 512
        help
            Trunca tramas superiores a este tamaño (512 B cubre holgadamente
            cualquier cabecera 802.11 + IEs de gestión y mensajes EAPOL M1-M4).

    config WARDRIVE_BLE_FUSION
        bool "Fusión BLE: escáner NimBLE pasivo simultáneo (BLE-Recon integrado)"
        depends on BT_ENABLED && BT_NIMBLE_ENABLED
        default y
        help
            Arranca un escaneo BLE continuo 100 % pasivo (nunca emite SCAN_REQ)
            coexistente con el escaneo WiFi (requiere CONFIG_SW_COEXIST_ENABLE,
            que se activa automáticamente con BT+WiFi). Cada ciclo de escaneo
            añade al payload JSONL un bloque "ble" con dispositivos únicos,
            clasificación iBeacon/Eddystone/FindMy/otros y la tabla de los
            dispositivos más fuertes. Desactívalo si necesitas el RAM/heap
            máximo para el buffer PCAP.

    config WARDRIVE_MAX_BLE_DEVICES
        int "Dispositivos BLE por ciclo en el payload JSONL"
        depends on WARDRIVE_BLE_FUSION
        range 8 64
        default 24
        help
            Tamaño de la tabla de dispositivos BLE (los más fuertes por RSSI)
            embebida en cada payload JSONL. El conteo de dispositivos únicos
            del ciclo es independiente de este tope (caché de 96 direcciones).

    config WARDRIVE_DEBUG_LEGACY_SCAN
        bool "DEBUG: conservar el bucle de escaneo ACTIVO del baseline"
        default n
        help
            Reproduce el comportamiento del baseline (escaneo activo cada
            N ms, solo log de resumen; el NVS de datos ya está eliminado).
            Su único propósito es la comparación A/B del Gate 2. NO es el
            modo de operación del sensor.

    config WARDRIVE_DEBUG_DUMP_JSON
        bool "DEBUG: volcar el JSONL completo de cada escaneo"
        default n
        help
            Imprime por serial la línea JSON completa de cada escaneo.
            Necesario para validar el payload v1 en el Gate 2 (copiar la
            línea y pasarla por jq o validate.py). NO activar en
            producción: genera un log masivo.

endmenu
```
